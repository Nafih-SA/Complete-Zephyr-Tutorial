## prj.conf
```kconfig
##########
# for BLE
##########
# Incresed stack due to settings API usage
CONFIG_SYSTEM_WORKQUEUE_STACK_SIZE=2048

CONFIG_BT=y
CONFIG_BT_DEBUG_LOG=y
CONFIG_BT_SMP=y
CONFIG_BT_SIGNING=y
CONFIG_BT_PERIPHERAL=y
CONFIG_BT_MAX_CONN=2
CONFIG_BT_MAX_PAIRED=2
### GATT Device Information service ###
CONFIG_BT_DIS=y
CONFIG_BT_DIS_PNP=n
CONFIG_BT_ATT_PREPARE_COUNT=5
# CONFIG_BT_BAS=y
CONFIG_BT_HRS=y
CONFIG_BT_PRIVACY=y
CONFIG_BT_DEVICE_NAME="Zephyr nRF52840 Enverse"
CONFIG_BT_DEVICE_APPEARANCE=1157
CONFIG_BT_DEVICE_NAME_DYNAMIC=y
CONFIG_BT_DEVICE_NAME_MAX=65

CONFIG_BT_KEYS_OVERWRITE_OLDEST=y
CONFIG_BT_SETTINGS=y
CONFIG_FLASH=y
CONFIG_FLASH_PAGE_LAYOUT=y
CONFIG_FLASH_MAP=y
CONFIG_NVS=y
CONFIG_SETTINGS=y

# Turnoff to aboid possible race conditions
#CONFIG_BT_ATT_ENFORCE_FLOW=n
#Floating point support
CONFIG_CBPRINTF_FP_SUPPORT=y

#
# General 
#
CONFIG_STDOUT_CONSOLE=y
CONFIG_PRINTK=y
#
# I2C
#
CONFIG_I2C=y
#
# SPI
#
CONFIG_SPI=y
CONFIG_SPI_2=y
# CONFIG_NRFX_SPI=y
# CONFIG_NRFX_SPI0 is not set
# CONFIG_NRFX_SPI1 is not set
# CONFIG_NRFX_SPI2=y


#
# Build Options
#
CONFIG_KERNEL_BIN_NAME="zephyr"
CONFIG_OUTPUT_STAT=y
CONFIG_OUTPUT_DISASSEMBLY=y
# CONFIG_OUTPUT_DISASSEMBLE_ALL is not set
CONFIG_OUTPUT_PRINT_MEMORY_USAGE=y
# CONFIG_CLEANUP_INTERMEDIATE_FILES is not set
# CONFIG_BUILD_NO_GAP_FILL is not set
CONFIG_BUILD_OUTPUT_BIN=y
# CONFIG_BUILD_OUTPUT_EXE is not set
# CONFIG_BUILD_OUTPUT_S19 is not set
# CONFIG_BUILD_OUTPUT_STRIPPED is not set
# CONFIG_APPLICATION_DEFINED_SYSCALL is not set
# CONFIG_MAKEFILE_EXPORTS is not set
CONFIG_DEPRECATED_ZEPHYR_INT_TYPES=y

#
# C Library
#
# # CONFIG_MINIMAL_LIBC=y
# CONFIG_NEWLIB_LIBC=y

CONFIG_SENSOR=y
CONFIG_MPU6050=y
```

## src/main.c
```c
/*
 * Copyright (c) 2015 Intel Corporation
 *
 * SPDX-License-Identifier: Apache-2.0
 */

#include <errno.h>
#include <zephyr.h>
#include <sys/printk.h>
#include <device.h>
#include <drivers/i2c.h>
#include <stdio.h>

#include "bma_sensor.h"
#include "max30102.h"
#include "latchSensor.h"
#include "max30208.h"
#include "lightSensor.h"
#include "digitalPins.h"
#include "lcd.h"

/** BLE **/
#include <zephyr/types.h>
#include <stddef.h>
#include <string.h>
#include <settings/settings.h>

#include <bluetooth/bluetooth.h>
#include <bluetooth/hci.h>
#include <bluetooth/conn.h>
#include <bluetooth/uuid.h>
#include <bluetooth/gatt.h>
#include <bluetooth/services/hrs.h>
#include "hts.h"

/// Variable to store data ///
float temp_data = 0, light_data = 0;
uint16_t mpu_data = 0;
u32_t red, ir;
int steps = 0;
int heart_rate, sp02;
bool valid_hr, valid_sp02;

/***********								************/

// Primary Service UUID 
static struct bt_uuid_128 vnd_uuid = BT_UUID_INIT_128(
	0xf0, 0xde, 0xbc, 0x9a, 0x78, 0x56, 0x34, 0x12,
	0x78, 0x56, 0x34, 0x12, 0x78, 0x56, 0x34, 0x12);

// Primary Service Characteristic UUID(s)
static struct bt_uuid_128 vnd_enc_uuid = BT_UUID_INIT_128(
	0xf1, 0xde, 0xbc, 0x9a, 0x78, 0x56, 0x34, 0x12,
	0x78, 0x56, 0x34, 0x12, 0x78, 0x56, 0x34, 0x12);

static struct bt_uuid_128 vnd_auth_uuid = BT_UUID_INIT_128(
	0xf2, 0xde, 0xbc, 0x9a, 0x78, 0x56, 0x34, 0x12,
	0x78, 0x56, 0x34, 0x12, 0x78, 0x56, 0x34, 0x12);

static const struct bt_uuid_128 vnd_long_uuid = BT_UUID_INIT_128(
	0xf3, 0xde, 0xbc, 0x9a, 0x78, 0x56, 0x34, 0x12,
	0x78, 0x56, 0x34, 0x12, 0x78, 0x56, 0x34, 0x12);

static const struct bt_uuid_128 vnd_signed_uuid = BT_UUID_INIT_128(
	0xf3, 0xde, 0xbc, 0x9a, 0x78, 0x56, 0x34, 0x13,
	0x78, 0x56, 0x34, 0x12, 0x78, 0x56, 0x34, 0x13);

static const struct bt_uuid_128 vnd_write_cmd_uuid = BT_UUID_INIT_128(
	0xf4, 0xde, 0xbc, 0x9a, 0x78, 0x56, 0x34, 0x12,
	0x78, 0x56, 0x34, 0x12, 0x78, 0x56, 0x34, 0x12);

static uint8_t vnd_value[] = { 'a', 'b', 'c', 'd', 'e', '1' };

#define MAX_DATA 74
static uint8_t vnd_long_value[] = {
		  'V', 'e', 'n', 'd', 'o', 'r', ' ', 'd', 'a', 't', 'a', '1',
		  'V', 'e', 'n', 'd', 'o', 'r', ' ', 'd', 'a', 't', 'a', '2',
		  'V', 'e', 'n', 'd', 'o', 'r', ' ', 'd', 'a', 't', 'a', '3',
		  'V', 'e', 'n', 'd', 'o', 'r', ' ', 'd', 'a', 't', 'a', '4',
		  'V', 'e', 'n', 'd', 'o', 'r', ' ', 'd', 'a', 't', 'a', '5',
		  'V', 'e', 'n', 'd', 'o', 'r', ' ', 'd', 'a', 't', 'a', '6',
		  '.', ' ' };
		  
static uint8_t simulate_vnd;
static uint8_t indicating;
static struct bt_gatt_indicate_params ind_params;

/* Primary Service read callback */
static ssize_t read_vnd(struct bt_conn *conn, const struct bt_gatt_attr *attr,
			void *buf, uint16_t len, uint16_t offset)
{
	const char *value = attr->user_data;

	return bt_gatt_attr_read(conn, attr, buf, len, offset, value,
				 strlen(value));
}

/* Primary Service write callback */
static ssize_t write_vnd(struct bt_conn *conn, const struct bt_gatt_attr *attr,
			 const void *buf, uint16_t len, uint16_t offset,
			 uint8_t flags)
{
	uint8_t *value = attr->user_data;

	if (offset + len > sizeof(vnd_value)) {
		return BT_GATT_ERR(BT_ATT_ERR_INVALID_OFFSET);
	}

	memcpy(value + offset, buf, len);

	return len;
}

/* Primary Service Configuration changed callback */
static void vnd_ccc_cfg_changed(const struct bt_gatt_attr *attr, uint16_t value)
{
	simulate_vnd = (value == BT_GATT_CCC_INDICATE) ? 1 : 0;
	bool notif_enabled = (value == BT_GATT_CCC_NOTIFY);

	printk("CSTM notifications %s", notif_enabled ? "enabled" : "disabled");
}

static void indicate_cb(struct bt_conn *conn,
			struct bt_gatt_indicate_params *params, uint8_t err)
{
	printk("Indication %s\n", err != 0U ? "fail" : "success");
}

static void indicate_destroy(struct bt_gatt_indicate_params *params)
{
	printk("Indication complete\n");
	indicating = 0U;
}


static ssize_t read_long_vnd(struct bt_conn *conn,
			     const struct bt_gatt_attr *attr, void *buf,
			     uint16_t len, uint16_t offset)
{
	const char *value = attr->user_data;

	return bt_gatt_attr_read(conn, attr, buf, len, offset, value,
				 sizeof(vnd_long_value));
}

static ssize_t write_long_vnd(struct bt_conn *conn,
			      const struct bt_gatt_attr *attr, const void *buf,
			      uint16_t len, uint16_t offset, uint8_t flags)
{
	uint8_t *value = attr->user_data;

	if (flags & BT_GATT_WRITE_FLAG_PREPARE) {
		return 0;
	}

	if (offset + len > sizeof(vnd_long_value)) {
		return BT_GATT_ERR(BT_ATT_ERR_INVALID_OFFSET);
	}

	memcpy(value + offset, buf, len);

	return len;
}

static struct bt_gatt_cep vnd_long_cep = {
	.properties = BT_GATT_CEP_RELIABLE_WRITE,
};

static int signed_value;

static ssize_t read_signed(struct bt_conn *conn, const struct bt_gatt_attr *attr,
			   void *buf, uint16_t len, uint16_t offset)
{
	const char *value = attr->user_data;

	return bt_gatt_attr_read(conn, attr, buf, len, offset, value,
				 sizeof(signed_value));
}

static ssize_t write_signed(struct bt_conn *conn, const struct bt_gatt_attr *attr,
			    const void *buf, uint16_t len, uint16_t offset,
			    uint8_t flags)
{
	uint8_t *value = attr->user_data;

	if (offset + len > sizeof(signed_value)) {
		return BT_GATT_ERR(BT_ATT_ERR_INVALID_OFFSET);
	}

	memcpy(value + offset, buf, len);

	return len;
}


/************* 'Send To' function	*************/
static ssize_t write_without_rsp_vnd(struct bt_conn *conn,
				     const struct bt_gatt_attr *attr,
				     const void *buf, uint16_t len, uint16_t offset,
				     uint8_t flags)
{
	uint8_t *value = attr->user_data;
	
	// printk(value);	// To print received value

	/* Write request received. Reject it since this char only accepts
	 * Write Commands.
	 */
	if (!(flags & BT_GATT_WRITE_FLAG_CMD)) {
		return BT_GATT_ERR(BT_ATT_ERR_WRITE_REQ_REJECTED);
	}

	if (offset + len > sizeof(vnd_value)) {
		return BT_GATT_ERR(BT_ATT_ERR_INVALID_OFFSET);
	}

	memcpy(value + offset, buf, len);

	return len;
}

/************* Service Table of "unknown service" *************/
/* Vendor Primary Service Declaration */
BT_GATT_SERVICE_DEFINE(vnd_svc,							//Macro that define and register a service
	BT_GATT_PRIMARY_SERVICE(&vnd_uuid),					//Primary Service Declaration Macro
	BT_GATT_CHARACTERISTIC(&vnd_enc_uuid.uuid,			//Characteristic and Value Declaration Macro (Chara uuid,
			       BT_GATT_CHRC_READ | BT_GATT_CHRC_WRITE |	//Characteristic Attribute properties,
			       BT_GATT_CHRC_INDICATE /*| BT_GATT_CHRC_NOTIFY*/,
			       BT_GATT_PERM_READ_ENCRYPT |			//Characteristic Attribute access permissions,
			       BT_GATT_PERM_WRITE_ENCRYPT,
			       read_vnd, write_vnd, vnd_value),		//read,write Callbacks, Attribute value)
	BT_GATT_CCC(vnd_ccc_cfg_changed,					//Client Characteristic Configuration Declaration Macro
		    BT_GATT_PERM_READ | BT_GATT_PERM_WRITE_ENCRYPT), //CCC Access permissons
	BT_GATT_CHARACTERISTIC(&vnd_auth_uuid.uuid,
			       BT_GATT_CHRC_READ | BT_GATT_CHRC_WRITE,
			       BT_GATT_PERM_READ_AUTHEN |
			       BT_GATT_PERM_WRITE_AUTHEN,
			       read_vnd, write_vnd, vnd_value),
	BT_GATT_CHARACTERISTIC(&vnd_long_uuid.uuid, BT_GATT_CHRC_READ |
			       BT_GATT_CHRC_WRITE | BT_GATT_CHRC_EXT_PROP,
			       BT_GATT_PERM_READ | BT_GATT_PERM_WRITE |
			       BT_GATT_PERM_PREPARE_WRITE,
			       read_long_vnd, write_long_vnd, &vnd_long_value),
	BT_GATT_CEP(&vnd_long_cep),							//Characteristic Extended Properties Declaration Macro
	BT_GATT_CHARACTERISTIC(&vnd_signed_uuid.uuid, BT_GATT_CHRC_READ |
			       BT_GATT_CHRC_WRITE | BT_GATT_CHRC_AUTH,
			       BT_GATT_PERM_READ | BT_GATT_PERM_WRITE,
			       read_signed, write_signed, &signed_value),
	BT_GATT_CHARACTERISTIC(&vnd_write_cmd_uuid.uuid,
			       BT_GATT_CHRC_WRITE_WITHOUT_RESP,
			       BT_GATT_PERM_WRITE, NULL,
			       write_without_rsp_vnd, &vnd_value),
);

/************* RSC Service **************/

static void rscm_ccc_cfg_changed(const struct bt_gatt_attr *attr, uint16_t value)
{
	ARG_UNUSED(attr);

	bool notif_enabled = (value == BT_GATT_CCC_NOTIFY);

	printk("RSCS notifications %s \n", notif_enabled ? "enabled" : "disabled");
}


#define BT_UUID_RSC BT_UUID_DECLARE_16(0x1814)
#define BT_UUID_RSC_MEASUREMENT BT_UUID_DECLARE_16(0x2A53)
#define BT_UUID_RSC_FEATURE BT_UUID_DECLARE_16(0x2A54)


BT_GATT_SERVICE_DEFINE(rsc_svc,
	BT_GATT_PRIMARY_SERVICE(BT_UUID_RSC),
	BT_GATT_CHARACTERISTIC(BT_UUID_RSC_MEASUREMENT, BT_GATT_CHRC_NOTIFY,
			       BT_GATT_PERM_NONE, NULL, NULL, NULL),
	BT_GATT_CCC(rscm_ccc_cfg_changed,
		    BT_GATT_PERM_READ | BT_GATT_PERM_WRITE),
	BT_GATT_CHARACTERISTIC(BT_UUID_RSC_FEATURE, BT_GATT_CHRC_READ,
			       BT_GATT_PERM_NONE, NULL, NULL, NULL),
	/* more optional Characteristics */
);

// Callback functions
int bt_rsc_notify(uint32_t running_speed)
{
	int rc;
	static uint32_t i;
	static uint32_t rsc[2];

	rsc[0] = 0x01010002; // Instantaneous Stride Length, Total Distance Present
	rsc[1] = i*10;
	// rsc[2] = 0;
	// rsc[3] = 2;
	i++;
	if (i>10000)
		i = 0;

	rc = bt_gatt_notify(NULL, &rsc_svc.attrs[1], &rsc, sizeof(rsc));

	return rc == -ENOTCONN ? 0 : rc;
}

/************* Advertisement Data *************/
//u8_t ----> unsigned char
static volatile uint8_t mfg_data[] = { 0x4c, 0x00, 0x00, 0x00};
static const struct bt_data ad[] = {
	BT_DATA_BYTES(BT_DATA_FLAGS, (BT_LE_AD_GENERAL | BT_LE_AD_NO_BREDR)),
	BT_DATA_BYTES(BT_DATA_UUID16_ALL,
			// BT_UUID_16_ENCODE(BT_UUID_CTS_VAL),
			// BT_UUID_16_ENCODE(BT_UUID_BAS_VAL),
			BT_UUID_16_ENCODE(BT_UUID_HRS_VAL)),
	BT_DATA(BT_DATA_MANUFACTURER_DATA, mfg_data, 4),
	BT_DATA_BYTES(BT_DATA_UUID128_ALL,
		      0xf0, 0xde, 0xbc, 0x9a, 0x78, 0x56, 0x34, 0x12,
		      0x78, 0x56, 0x34, 0x12, 0x78, 0x56, 0x34, 0x12),
};

static void connected(struct bt_conn *conn, uint8_t err)
{
	if (err) {
		printk("Connection failed (err 0x%02x)\n", err);
	} else {
		printk("Connected\n");
	}
}

static void disconnected(struct bt_conn *conn, uint8_t reason)
{
	printk("Disconnected (reason 0x%02x)\n", reason);
}

static struct bt_conn_cb conn_callbacks = {
	.connected = connected,
	.disconnected = disconnected,
};

static void 
bt_ready(void)
{
	int err;

	printk("Bluetooth initialized\n");

	// cts_init();
	hts_init();		// Health Thermometer Initialize

	if (IS_ENABLED(CONFIG_SETTINGS)) {
		settings_load();
	}

	err = bt_le_adv_start(BT_LE_ADV_CONN_NAME, ad, ARRAY_SIZE(ad), NULL, 0);
	if (err) {
		printk("Advertising failed to start (err %d)\n", err);
		return;
	}

	printk("Advertising successfully started\n");
}

static void auth_passkey_display(struct bt_conn *conn, unsigned int passkey)
{
	char addr[BT_ADDR_LE_STR_LEN];

	bt_addr_le_to_str(bt_conn_get_dst(conn), addr, sizeof(addr));

	printk("Passkey for %s: %06u\n", addr, passkey);
}

static void auth_cancel(struct bt_conn *conn)
{
	char addr[BT_ADDR_LE_STR_LEN];

	bt_addr_le_to_str(bt_conn_get_dst(conn), addr, sizeof(addr));

	printk("Pairing cancelled: %s\n", addr);
}

static struct bt_conn_auth_cb auth_cb_display = {
	.passkey_display = auth_passkey_display,
	.passkey_entry = NULL,
	.cancel = auth_cancel,
};

/************* 
static void bas_notify(void)
{
	uint8_t battery_level = bt_bas_get_battery_level();

	battery_level--;

	if (!battery_level) {
		battery_level = 100U;
	}

	bt_bas_set_battery_level(battery_level);
}
**************/

static void hrs_notify(void)
{
	// static uint8_t heartrate = 90U;

	/* Heartrate measurements simulation */
	// heartrate++;
	if (heart_rate > 200U) {
		heart_rate = 0U;
	}

	bt_hrs_notify(heart_rate);
}


/***********								************/
/**
 * @file Enverse Smart Wearable Firmware
 */

// LCD values //
bool lcd_init = 0;
#define DISPLAY_MODE_BOOTING 0
#define DISPLAY_MODE_TIME 1
#define DISPLAY_MODE_OFF 2
#define DISPLAY_MODE_ON 3
#define DISPLAY_MODE_VALUES 4
int display_mode = DISPLAY_MODE_BOOTING;

#define SENSOR_MODE_IDLE 0
#define SENSOR_MODE_READ_ALL 1
int sensor_mode = SENSOR_MODE_IDLE;



//////////////////////////////
bool latch_status = true;

/// FSM variables  ///
int current_state_display = DISPLAY_MODE_BOOTING;

#define MAXIMUM_BRIGHTNESS 255
#define MINIMUM_BRIGHTNESS 50
int brightness_value = MAXIMUM_BRIGHTNESS;
int current_brightness = MAXIMUM_BRIGHTNESS;
int brightness_step = 15;
int logo_colour[] = {RED, BLUE, GREEN, WHITE};

#define LIGHT_BUFFER_COUNT 20

extern bool temperature_logo[50][50];
extern bool steps_logo[50][50];
extern bool heart_logo[50][50];
extern bool spio2_logo[50][50];

void main(void)
{
	int err;

	err = bt_enable(NULL);
	if (err) {
		printk("Bluetooth init failed (err %d)\n", err);
		return;
	}

	bt_ready();

	bt_conn_cb_register(&conn_callbacks);
	bt_conn_auth_cb_register(&auth_cb_display);
	printk("\n\n Booting Enverse Smart Watch \n\n");
	while (display_mode == DISPLAY_MODE_BOOTING)
	{
		k_msleep(1000);
	}
	while (1)
	{
		// display_mode = DISPLAY_MODE_TIME;
		// sensor_mode = SENSOR_MODE_IDLE;
		k_msleep(5000);
		sensor_mode = SENSOR_MODE_READ_ALL;
		display_mode = DISPLAY_MODE_VALUES;
		k_msleep(10000);
		hts_indicate(38.22);
	}
}

void refresh_display()
{
	resetDisplay();
	k_msleep(1);
	LCD_Init();
	SetBrightness(current_brightness);
}
void display_task(void)
{
	LCD_Init();
	SetBrightness(255);
	while (1)
	{
		if (brightness_value > MAXIMUM_BRIGHTNESS)
			brightness_value = MAXIMUM_BRIGHTNESS;
		if (brightness_value < MINIMUM_BRIGHTNESS)
			brightness_value = MINIMUM_BRIGHTNESS;
		if (current_brightness < brightness_value)
			current_brightness += brightness_step;
		else if (current_brightness > brightness_value)
			current_brightness -= brightness_step;
		if (current_brightness > MAXIMUM_BRIGHTNESS)
			current_brightness = MAXIMUM_BRIGHTNESS;
		if (current_brightness < MINIMUM_BRIGHTNESS)
			current_brightness = MINIMUM_BRIGHTNESS;
		SetBrightness(current_brightness);
		//printf("brightness %d\n",current_brightness);
		switch (display_mode)
		{
		case DISPLAY_MODE_BOOTING:
			DispStr("BOOTING", 150, 150, WHITE, BLACK);
			static int i = 0;
			DispLogo(logo_colour[i]);
			if (i >= (sizeof(logo_colour) / sizeof(int)))
				i = 0;
			else
				i++;
			current_state_display = DISPLAY_MODE_BOOTING;
			break;
		case DISPLAY_MODE_TIME:
			if (current_state_display != DISPLAY_MODE_TIME)
				refresh_display();
			DispStr("10 : 10", 150, 150, WHITE, BLACK);
			DispStr("11/11  Wed", 130, 200, WHITE, BLACK);
			current_state_display = DISPLAY_MODE_TIME;
			break;
		case DISPLAY_MODE_VALUES:
			if (current_state_display != DISPLAY_MODE_VALUES)
			{
				refresh_display();
				DispIcon(steps_logo, BLUE, 100, 100, 50, 50);
				DispStr("Steps", 90, 160, WHITE, BLACK);

				DispIcon(heart_logo, RED, 260, 100, 50, 50);
				DispStr("H R", 264, 160, WHITE, BLACK);

				DispIcon(temperature_logo, GREEN, 100, 280, 50, 50);
				DispStr("Temp", 94, 340, WHITE, BLACK);

				DispIcon(spio2_logo, RED, 260, 280, 50, 50);
				DispStr("Spo2", 250, 340, WHITE, BLACK);
			}

			char step_count[6];
			sprintf(step_count, "%d", steps);
			DispStr(step_count, 120, 190, WHITE, BLACK); //update step count

			if (valid_hr)
			{
				char hr[6];
				sprintf(hr, "%d  ", heart_rate);
				DispStr(hr, 270, 190, WHITE, BLACK); //update hr
			}

			char temperature_value[6];
			sprintf(temperature_value, "%.2f", temp_data);
			unsigned char *t = "38.2";		   //discard the read value and use constant 38.2 as value
			DispStr(t, 90, 370, WHITE, BLACK); //update temperature

			if (valid_sp02)
			{
				char sp[6];
				sprintf(sp, "%d", sp02);
				DispStr(sp, 260, 370, WHITE, BLACK); //update spo2
			}

			if(!latch_status)
				DispStr("Detached !", 128, 30, RED, BLACK);
			else
				DispStr("Detached !", 128, 30, BLACK, BLACK);
			current_state_display = DISPLAY_MODE_VALUES;

			char Accx[6];
			mpu_data = mpu_data-213;
			sprintf(Accx, "%d", mpu_data);
			DispStr(Accx, 190, 240, WHITE, BLACK); //update acceleration

			break;
		}
	}
}

void sensors_read_task(void)
{
	initialize_bma();
	stepCounterEnable();
	init_max30102();
	set_max30102_for_reading_data();
	first_data_read();
	init_max30208();
	configure_max30208();
	configure_mpu6050();

	display_mode = DISPLAY_MODE_TIME;
	while (1)
	{
		switch (sensor_mode)
		{
		case SENSOR_MODE_IDLE:
			k_msleep(500);
			break;
		case SENSOR_MODE_READ_ALL:
			read_heart_rate_spio2(&heart_rate, &sp02, &valid_hr, &valid_sp02);
			max30208_read_temp(&temp_data);
			steps = getStepCounterOutput();
			mpu6050_read_Acc(&mpu_data);
			hrs_notify();
			bt_rsc_notify(33);
			// printf("Steps= %d. Temperature = %.2f . Heart Rate = %d . SpO2 = %d . MPU = %d\n", steps, temp_data, heart_rate, sp02, mpu_data);
			k_msleep(10);
			break;
		}
	}
}

void latch_sensor_task(void)
{
	init_latch();
	init_output();
	while (1)
	{
		latch_status = detect_latch();
		k_msleep(500);
	}
}

void vibration_task()
{
	while (1)
	{
		if (latch_status == false)
			toggle_motor(1); //1
		else
			toggle_motor(0); //0
		k_msleep(500);
	}
}

void buzzer_task()
{
	while (1)
	{
		if (latch_status == false)
			toggle_buzzer(1);
		k_msleep(500);
	}
}

void brightness_task()
{
	float light_data[LIGHT_BUFFER_COUNT];
	for (int i = 0; i < LIGHT_BUFFER_COUNT; i++)
		light_data[i] = AnalogRead(4);
	while (1)
	{
		float sum = 0;
		for (int i = 0; i < LIGHT_BUFFER_COUNT - 1; i++)
		{
			light_data[i] = light_data[i + 1];
			sum = sum + light_data[i];
		}
		light_data[LIGHT_BUFFER_COUNT - 1] = AnalogRead(4);
		sum = sum + light_data[LIGHT_BUFFER_COUNT - 1];
		float light_value = sum / LIGHT_BUFFER_COUNT;
		//printf("light =%f\n",light_value);
		brightness_value = 75.55 * light_value;
		k_msleep(1000);
		hrs_notify();
	}
}


K_THREAD_DEFINE(sensors_read_task_id, 1024, sensors_read_task, NULL, NULL, NULL,
				0, 0, 10);
K_THREAD_DEFINE(latch_sensor_task_id, 512, latch_sensor_task, NULL, NULL, NULL,
				0, 0, 100);
K_THREAD_DEFINE(buzzer_task_id, 256, buzzer_task, NULL, NULL, NULL,
				0, 0, 100);
K_THREAD_DEFINE(vibration_task_id, 256, vibration_task, NULL, NULL, NULL,
				0, 0, 100);
K_THREAD_DEFINE(display_task_id, 512, display_task, NULL, NULL, NULL,
				0, 0, 1000);
K_THREAD_DEFINE(brightness_task_id, 512, brightness_task, NULL, NULL, NULL,
				0, 0, 2000);
```

## src/bma_sensor.h
```c
#pragma once
#include <errno.h>
#include <zephyr.h>
#include <sys/printk.h>
#include <device.h>
#include <drivers/i2c.h>
#include "bma456.h"

#define I2C_DEV DT_LABEL(DT_NODELABEL(arduino_i2c))

struct BMA456_ACCEL_DATA
{
    int datax;
    int datay;
    int dataz;
    u8_t result;
};

typedef enum
{
    CIC_AVG = 0,
    CONTINUOUS,
} MA456_PERF_MODE;

typedef enum
{
    OSR4_AVG1 = 0,
    OSR2_AVG2,
    NORMAL_AVG4,
    CIC_AVG8,
    RES_AVG16,
    RES_AVG32,
    RES_AVG64,
    RES_AVG128,
} MA456_BW;

typedef enum
{
    ODR_0_78_HZ = 1,
    ODR_1_5_HZ,
    ODR_3_1_HZ,
    ODR_6_25_HZ,
    ODR_12_5_HZ,
    ODR_25_HZ,
    ODR_50_HZ,
    ODR_100_HZ,
    ODR_200_HZ,
    ODR_400_HZ,
    ODR_800_HZ,
    ODR_1600_HZ,
} MBA456_ODR;

typedef enum
{
    RANGE_2G = 0,
    RANGE_4G,
    RANGE_8G,
    RANGE_16G,
} MA456_RANGE;

typedef enum
{
    PHONE_CONFIG = 0,
    WRIST_CONFIG = 1,
} MA456_PLATFORM_CONF;

void initialize_bma();
u16_t init_accel();
struct BMA456_ACCEL_DATA read_accel();
u16_t stepCounterEnable();

void getAcceleration(float *x, float *y, float *z);

u32_t getTemperature(void);

u32_t getStepCounterOutput(void);
```

## src/max30102.h
```c
#pragma once
#include <errno.h>
#include <zephyr.h>
#include <drivers/gpio.h>
#include <sys/printk.h>
#include <device.h>
#include <drivers/i2c.h>

#define FLAGS_OR_ZERO(node)                          \
    COND_CODE_1(DT_PHA_HAS_CELL(node, gpios, flags), \
                (DT_GPIO_FLAGS(node, gpios)),        \
                (0))

/*
 * Get button configuration from the devicetree sw0 alias.
 *
 * At least a GPIO device and pin number must be provided. The 'flags'
 * cell is optional.
 */

#define SW1_NODE DT_ALIAS(sw1)

#define SW1_GPIO_LABEL DT_GPIO_LABEL(SW1_NODE, gpios)
#define SW1_GPIO_PIN DT_GPIO_PIN(SW1_NODE, gpios)
#define SW1_GPIO_FLAGS (GPIO_INPUT | FLAGS_OR_ZERO(SW1_NODE))

#define I2C_DEV DT_LABEL(DT_NODELABEL(arduino_i2c))

/******************************************************************************/
/*********** PULSE OXIMETER AND HEART RATE REGISTER MAPPING  **************/
/******************************************************************************/

// status registers
#define MAX30102_INT1_STATUS 0x00
#define MAX30102_INT2_STATUS 0x01
#define MAX30102_INT1_ENABLE 0x02
#define MAX30102_INT2_ENABLE 0x03

// FIFO registers
#define MAX30102_FIFO_W_POINTER 0x04
#define MAX30102_OVR_COUNTER 0x05
#define MAX30102_FIFO_R_POINTER 0x06
#define MAX30102_FIFO_DATA_REG 0x07

// configuration registers
#define MAX30102_FIFO_CONFIG 0x08
#define MAX30102_CONFIG 0x09
#define MAX30102_SPO2_CONFIG 0x0A
#define MAX30102_LED_CONFIG_1 0x0C
#define MAX30102_LED_CONFIG_2 0x0D
#define MAX30102_REG_PILOT_PA 0x10

// temperature registers
#define MAX30102_TEMP_INTEGER 0x1F
#define MAX30102_TEMP_FRACTION 0x20
#define MAX30102_TEMP_CONFIG 0x21

// PART ID registers
#define MAX30102_REVISION_ID 0xFE
#define MAX30102_PART_ID 0xFF

#define I_AM_MAX30102 0x15

/************************************** REGISTERS VALUE *******************************************/

#define MAX30102_ADDRESS 0x57

#define MAX3_OK 0x00

u16_t init_max30102();
bool max30102_reset();
u16_t set_max30102_for_reading_data();

static uint16_t max30102_i2c_write(uint8_t reg, uint8_t *data, uint16_t len);
static uint16_t max30102_i2c_read(u8_t reg, u8_t *data, u16_t len);
u16_t max30102_read_fifo(uint32_t *pun_red_led, uint32_t *pun_ir_led);
void read_heart_rate_spio2(int *rate, int *spo2, bool *valid_hr, bool *valid_spo2);
void first_data_read();
```

## src/max30208.c
```c
#include <stdio.h>
#include <drivers/sensor.h>
#include "max30208.h"


//#define logging 0

static int write_bytes(struct device *i2c_dev, u8_t addr, u8_t *data, u32_t num_bytes, u16_t slaveAddr)
{
    u8_t ret = 0x00;
#ifdef logging
    printk("Writing register - ox%x . Bytes =%d\n", addr, num_bytes);
#endif
    ret = i2c_reg_write_byte(i2c_dev, slaveAddr, addr, data);
#ifdef logging
    if (ret == MAX_OK)
        printk("Wrote Data\n");
    else
        printk("Failed to write\n");
#endif
    return ret;
}

static int read_bytes(struct device *i2c_dev, u8_t addr, u8_t *data, u32_t num_bytes, u16_t slaveAddr)
{
#ifdef logging
    printk("Reading register ox%x . Bytes =%d\n", addr, num_bytes);
#endif
    u8_t ret = i2c_reg_read_byte(i2c_dev, slaveAddr, addr, data);
#ifdef logging
    if (ret == MAX_OK)
        printk("Data read. Value = 0x%x\n", *(data));
#endif
    return ret;
}


/* MAX30102 i2c write function */
static uint16_t max30208_i2c_write(uint8_t reg, uint8_t *data, uint16_t len)
{
    struct device *i2c_dev;
    i2c_dev = device_get_binding(I2C_DEV);
    return write_bytes(i2c_dev, reg, data, len, MAX30208_ADDRESS);
}

/* MAX30102 i2c read function */
static uint16_t max30208_i2c_read(u8_t reg, u8_t *data, u16_t len)
{
    struct device *i2c_dev;
    i2c_dev = device_get_binding(I2C_DEV);
    return read_bytes(i2c_dev, reg, data, len, MAX30208_ADDRESS);
}

u16_t init_max30208()
{
    u8_t chipId;
    u16_t rslt = 0x00;
    rslt = max30208_i2c_read(MAX30208_PART_ID, &chipId, 1);
    if (rslt == MAX_OK)
    {
        if (chipId == I_AM_MAX30208)
        {
            printk("Communication with MAX30208 : OK\n");
        }
        else
        {
            printk("Communication with MAX30208 : FAILED!!!\n");
        }
    }
    else
    {
        printk("Communication with MAX30208 : FAILED!!!\n I2C error %d\n", rslt);
    }
    return rslt;
}

u16_t configure_max30208()
{
    u16_t rslt = MAX_OK;
    rslt |= max30208_i2c_write(MAX30208_INT_ENABLE, 0x00, 1);
    rslt |= max30208_i2c_write(MAX30208_FIFO_W_POINTER, 0x00, 1);
    rslt |= max30208_i2c_write(MAX30208_FIFO_R_POINTER, 0x00, 1);
    rslt |= max30208_i2c_write(MAX30208_OVR_COUNTER, 0x00, 1);
    rslt |= max30208_i2c_write(MAX30208_FIFO_CONFIG_1, 0x0F, 1);
    rslt |= max30208_i2c_write(MAX30208_FIFO_CONFIG_2, 0x1A, 1);
    rslt |= max30208_i2c_write(MAX30208_TEMP_SETUP, 0xC1, 1);
    if (rslt == MAX_OK)
        printk("CONFIGURING MAX30208 : OK\n");
    else
        printk("CONFIGURING MAX30208 : FAILED!!!\n");

    return (rslt);
}

u16_t max30208_read_fifo(int *data)
{
    u16_t rslt = MAX_OK;
    *data = 0;
    u16_t temp_dat[2] = {0, 0};
    int samples = 1, sum = 0;
    rslt |= max30208_i2c_write(MAX30208_TEMP_SETUP, 0xC1, 1);
    for (int j = 0; j < samples; j++)
    {
        for (int i = 0; i < 2; i++)
        {
            u8_t temp;
            max30208_i2c_read(MAX30208_FIFO_DATA_REG, &temp, 1);
            temp_dat[i] = temp;
        }
        sum = sum + (temp_dat[0] << 8) + temp_dat[1];
    }
    *data = sum / samples;
    u8_t temp;
    max30208_i2c_read(MAX30208_FIFO_R_POINTER, &temp, 1);
    //rslt |= max30208_i2c_write(MAX30208_FIFO_CONFIG_2, 0x1A, 1);
    *data = (temp_dat[0] << 8) + temp_dat[1];
    if (rslt != MAX_OK)
        // printk("READING FROM MAX30208 FIFO : FAILED\n");
    return rslt;
}

u16_t max30208_read_temp(float *value)
{
    int temp;
    u16_t rslt = 0x00;
    rslt |= max30208_read_fifo(&temp);
    if (temp & 0x8000)
    {
        temp = ~(temp - 1);
    }
    *value = (float)temp * 0.005;
    return rslt;
}



/* MPU6050 process */
/**************************************************
// A more appropriate way to interface mpu6050
//Devolopment inhibited halfway

static int process_mpu6050(const struct device *dev)
{
	struct sensor_value temperature;
	struct sensor_value accel[3];
	struct sensor_value gyro[3];
	int rc = sensor_sample_fetch(dev);

	if (rc == 0) {
		rc = sensor_channel_get(dev, SENSOR_CHAN_ACCEL_XYZ,
					accel);
	}
	if (rc == 0) {
		rc = sensor_channel_get(dev, SENSOR_CHAN_GYRO_XYZ,
					gyro);
	}
	if (rc == 0) {
		rc = sensor_channel_get(dev, SENSOR_CHAN_AMBIENT_TEMP,
					&temperature);
	}
	if (rc == 0) {
		printf("%g Cel\n"
		       "  accel %f %f %f m/s/s\n"
		       "  gyro  %f %f %f rad/s\n",
		       sensor_value_to_double(&temperature),
		       sensor_value_to_double(&accel[0]),
		       sensor_value_to_double(&accel[1]),
		       sensor_value_to_double(&accel[2]),
		       sensor_value_to_double(&gyro[0]),
		       sensor_value_to_double(&gyro[1]),
		       sensor_value_to_double(&gyro[2]));
	} else {
		printf("sample fetch/get failed: %d\n", rc);
	}

	return rc;
}
******************************************************/
/* MPU6050 i2c write function */
static uint16_t mpu6050_i2c_write(uint8_t reg, uint8_t *data, uint16_t len)
{
    struct device *i2c_dev;
    i2c_dev = device_get_binding(I2C_DEV);
    
    int ret;
    ret = write_bytes(i2c_dev, reg, data, 1,  MPU6050_ADDRESS);
    #ifdef logging
	if (ret) {
		printk("Error writing to MPU! error code (%d)\n", ret);
		return;
	} else {
		printk("Wrote 0xAE to address 0x00.\n");
	}
    #endif
    return ret;
}

/* MPU6050 i2c read function */
static uint16_t mpu6050_i2c_read(u8_t reg, u8_t *data, u16_t len)
{
    struct device *i2c_dev;
    int ret;
    i2c_dev = device_get_binding(I2C_DEV);
    ret =  read_bytes(i2c_dev, reg, data, len, MPU6050_ADDRESS);
    #ifdef log
    if (ret) {
		printk("Error reading from MPU6050! error code (%d)\n", ret);
		return;
	} else {
		printk("Read 0x%X from address %X.\n", *data, reg);
	}
    #endif
    return ret;
}

/*** Config MPU6050 ***/
void configure_mpu6050()
{
    int rslt;
	mpu6050_i2c_write(0x6B, 0x00, 1);	//Setting power
	mpu6050_i2c_write(0x1B, 0x00, 1);	//Setting Gyro
	mpu6050_i2c_write(0x38, 0x00, 1);	//Setting Accl
    
    mpu6050_i2c_read(0x75, &rslt, 1);   //Reading Who_AM_I register of MPU6050 
    if(rslt == 0x68)
        printk("CONFIGURING MPU6050 : OK\n");
    else
      printk("CONFIGURING MPU6050 : FAILED !!!\n");  
}

u16_t mpu6050_read_Acc(uint16_t *value)
{
    return mpu6050_i2c_read(0x3B, value, 2);
}
```

## src/max30208.h
```c
#pragma once
#include <errno.h>
#include <zephyr.h>
#include <sys/printk.h>
#include <device.h>
#include <drivers/i2c.h>

// #define I2C_DEV DT_LABEL(DT_ALIAS(i2c_0))   //Equivalent to DT_PROP(DT_ALIAS(i2c_0,label))
#define I2C_DEV DT_LABEL(DT_NODELABEL(arduino_i2c))     //Same as above definition but without using Alias name
// #define I2C_DEV DT_LABEL(DT_INST(0,max_max30102))    //A more appropriate way to do the same but alas! I couldn't 
                                                        // continue devolopment


// const char *const label = DT_LABEL(DT_INST(0, invensense_mpu6050));  //A more appropriate way to interface sensors
// const struct device *mpu6050 = device_get_binding(label);        //Devolopment inhibited halfway

/******************************************************************************/
/*********** TEMPERATURE SENSOR REGISTER MAPPING  **************/
/******************************************************************************/
 
// status registers
#define MAX30208_INT_STATUS                 0x00
#define MAX30208_INT_ENABLE                 0x01
 
// FIFO registers
#define MAX30208_FIFO_W_POINTER             0x04
#define MAX30208_FIFO_R_POINTER             0x05
#define MAX30208_OVR_COUNTER                0x06
#define MAX30208_FIFO_DATA_COUNTER          0x07
#define MAX30208_FIFO_DATA_REG              0x08
 
// configuration registers
#define MAX30208_FIFO_CONFIG_1              0x09
#define MAX30208_FIFO_CONFIG_2              0x0A
#define MAX30208_SYSTEM_CONTROL             0x0C
#define MAX30208_TEMP_SETUP                 0x14
 

 
// PART ID registers
#define MAX30208_PART_ID                    0xFF
 
#define I_AM_MAX30208                       0x30

#define MAX30208_ADDRESS                    0x50
#define MPU6050_ADDRESS                     0x68   

#define MAX_OK                              0x00


u16_t init_max30208();
u16_t configure_max30208();

void configure_mpu6050();
static uint16_t mpu6050_i2c_write(uint8_t reg, uint8_t *data, uint16_t len);
static uint16_t mpu6050_i2c_read(u8_t reg, u8_t *data, u16_t len);
u16_t mpu6050_read_Acc(uint16_t *value);
// static int process_mpu6050(const struct device *dev);    //Devolopment inhibited halfway

static uint16_t max30208_i2c_write(uint8_t reg, uint8_t *data, uint16_t len);
static uint16_t max30208_i2c_read(u8_t reg, u8_t *data, u16_t len);
u16_t max30208_read_fifo(int *temp_data);
u16_t max30208_read_temp(float *value);
```
