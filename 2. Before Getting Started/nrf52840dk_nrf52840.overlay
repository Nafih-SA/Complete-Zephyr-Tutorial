/*
 * Copyright (c) 2019 Nordic Semiconductor ASA
 *
 * SPDX-License-Identifier: Apache-2.0
 */

&i2c0 {
	mpu6050@68 {
		compatible = "invensense,mpu6050";
		reg = <0x68>;
		status = "okay";
		label = "MPU6050";
		int-gpios = <&gpio0 11 GPIO_ACTIVE_HIGH>;
	};
	/*
	max30102@57 {
		compatible = "max,max30102";
		reg = <0x57>;
		label = "MAX30102";
		int-gpios = <&gpio0 11 GPIO_ACTIVE_LOW>;
	};
	max30208@50 {
		compatible = "max,max20308";
		reg = <0x50>;
		status = "okay";
		label = "MAX30208";
		int-gpios = <&gpio0 11 GPIO_ACTIVE_HIGH>;
	};
	adt7420@48 {
		compatible = "adi,adt7420";
		reg = <0x48>;
		label = "ADT7420";
		int-gpios = <&gpio0 16 GPIO_ACTIVE_LOW>;
	};
	*/
};
/*
&spi2 {
	cs-gpios = <&led0 1 GPIO_ACTIVE_HIGH>;
	adxl372@0 {
		compatible = "tma,tma525C";
		reg = <0>;
		spi-max-frequency = <8000000>;
		label = "TMA525C";
		int1-gpios = <&gpio0 11 GPIO_ACTIVE_HIGH>;
	};
};
*/