## 4. The Envese Code/Code/build/Kconfig.modules
```kconfig
osource "C:/Users/Vinayan/ncs/v1.3.0/nrf/Kconfig.nrf"

osource "C:/Users/Vinayan/ncs/v1.3.0/bootloader/mcuboot/zephyr/Kconfig"

osource "C:/Users/Vinayan/ncs/v1.3.0/nrfxlib/Kconfig.nrfxlib"
```

## 4. The Envese Code/Code/build_nrf52840dk_nrf52840/Kconfig.modules
```kconfig
osource "C:/Users/IoT/ncs/v1.3.0/nrf/Kconfig.nrf"

osource "C:/Users/IoT/ncs/v1.3.0/bootloader/mcuboot/zephyr/Kconfig"

osource "C:/Users/IoT/ncs/v1.3.0/nrfxlib/Kconfig.nrfxlib"
```
